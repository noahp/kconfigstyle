## examples/Kconfig.complex-nesting
```kconfig
choice MEMFAULT_BUILD_ID_TYPE
        prompt "Build ID type"
        default MEMFAULT_USE_MEMFAULT_BUILD_ID if (MEMFAULT_SOC_FAMILY_ESP32 && !BOOTLOADER_MCUBOOT)
        default MEMFAULT_USE_GNU_BUILD_ID
        help
          Choose the type of build ID to include in the image

config MEMFAULT_USE_MEMFAULT_BUILD_ID
        bool "Use a Memfault build ID in an image"
        # Memfault build ID should be used if the ESP32 bootloader is used.
        # esptool.py generates the flashable image, which ignores the
        # .note.gnu.build-id section despite being marked as ALLOC.
        help
          Use a Memfault build ID in an image

menuconfig MEMFAULT_USE_GNU_BUILD_ID
        bool "Use a GNU build ID in an image"
        depends on !(MEMFAULT_SOC_FAMILY_ESP32 && !BOOTLOADER_MCUBOOT)

if MEMFAULT_USE_GNU_BUILD_ID

choice MEMFAULT_GNU_BUILD_ID_SOURCE
        prompt "GNU Build ID source"
        default MEMFAULT_GNU_BUILD_ID_SOURCE_CUSTOM if ARCH_POSIX
        default MEMFAULT_GNU_BUILD_ID_SOURCE_BUILTIN
        help
          Choose if a GNU build ID is generated by built-in SDK features
          or by other means

config MEMFAULT_GNU_BUILD_ID_SOURCE_BUILTIN
        bool "Built-in via Memfault SDK"
        help
          Use the Memfault SDK to generate and include a GNU build ID

config MEMFAULT_GNU_BUILD_ID_SOURCE_CUSTOM
        bool "Custom source"
        help
          Use a custom source to generate and include a GNU build ID
          Set the name of the GNU build ID symbol with MEMFAULT_GNU_BUILD_ID_SYMBOL
          in your application's memfault_platform_config.h

endchoice # MEMFAULT_GNU_BUILD_ID_SOURCE

endif # MEMFAULT_USE_GNU_BUILD_ID

endchoice # MEMFAULT_BUILD_ID_TYPE
```

## examples/Kconfig.pathological-help
```kconfig
config NETWORKING
	bool "Enable networking"
	help
	  Adds support for performing OTA updates via MCUboot. If an update is available,
	  the binary will be downloaded and installed in the secondary slot(slot1_partition).
	  By default, the device will be rebooted into the new firmware. Users can customize
	  the behavior after the update is downloaded by providing a custom implementation
	  of memfault_zephyr_fota_download_callback() and setting MEMFAULT_ZEPHYR_FOTA_DOWNLOAD_CALLBACK_CUSTOM=y.
	  For information on release management with Memfault: https://mflt.io/release-mgmt.

	  config use this config!



if YOLO

menu "Some choice settings"

choice SOME_CHOICE
	prompt "Select a choice"
	default SOME_CHOICE_OPTION_A if YOLO
	default SOME_CHOICE_OPTION_B
	help
	  Select your choice!

config SOME_CHOICE_OPTION_A
	bool "Option A"
	help
	  This is option A for the choice.
config SOME_CHOICE_OPTION_B
	bool "Option B"


	help
	  This is option B for the choice.

endchoice

endmenu # Some choice settings

	config YOLO_FEATURE
		bool "Enable YOLO feature"
		help
		  When enabled, __has_include is used to conditionally include the three Memfault
		  configuration files to a port if they exist instead of failing to compile if
		  they do not:
		  memfault_platform_config.h
		  memfault_metrics_heartbeat_config.def
		  memfault_trace_reason_user_config.def
endif  # YOLO

menuconfig ADVANCED_SETTINGS
    bool "Enable advanced settings"
    help
      Enable advanced settings for power users.
```
